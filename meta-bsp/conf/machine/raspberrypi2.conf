## meta-bsp/conf/machine/raspberrypi2.conf
```bitbake
#@TYPE: Machine
#@NAME: RaspberryPi 2 Development Board
#@DESCRIPTION: Machine configuration for the RaspberryPi 2

SOC_FAMILY = "rpi"
include conf/machine/include/soc-family.inc

DEFAULTTUNE ?= "cortexa7thf-neon-vfpv4"

require conf/machine/include/tune-cortexa7.inc

MACHINE_FEATURES = "apm usbhost keyboard vfat ext2 serial screen touchscreen alsa bluetooth wifi sdio"
SERIAL_CONSOLE = "115200 ttyAMA0"

# Inputs for machine-conf-runtime recipe
MACHINE_FEATURES += "headless"
VE_MKX_PORT = ""
VE_VEDIRECT_PORTS = ""
VE_RELAYS = ""

# Sort these out later
IMAGE_FSTYPES ?= "tar.bz2 ext3 rpi-sdimg"

# config of u-boot to be used
UBOOT_MACHINE = "rpi_2_config"
UBOOT_ENTRYPOINT = "0x80008000"
UBOOT_LOADADDRESS = "0x80008000"
UBOOT_SUFFIX = "bin"
#SPL_BINARY = "MLO" # bootcode.bin and start.elf ?

# Kernel name 
SDIMG_KERNELIMAGE ?= "kernel7.img"

KERNEL_IMAGETYPE = "uImage"
IMAGE_BOOT_FILES ?= "u-boot.${UBOOT_SUFFIX} uEnv.txt"

# Added dosfstools-native and mtools-native since wic otherwise
# fails on the build machine
EXTRA_IMAGEDEPENDS += "u-boot-raspberrypi2 dosfstools-native mtools-native"

# Note that this variable only affects images based on packagegroup-base, which
# does not include the core-image-minimal or core-image-full-cmdline images.
MACHINE_EXTRA_RDEPENDS += "kernel-modules kernel-image"

PREFERRED_PROVIDER_virtual/kernel ?= "linux-raspberrypi"
PREFERRED_PROVIDER_virtual/bootloader = "u-boot-raspberrypi2"

# Kernel Version
PREFERRED_VERSION_linux-raspberrypi ?= "4.1.%"

# Set Raspberrypi splash image
SPLASH = "psplash-raspberrypi"

KERNEL_DEVICETREE ?= " \
    bcm2709-rpi-2-b.dtb \
    bcm2710-rpi-3-b.dtb \
    \
    overlays/pitft22-overlay.dtb \
    overlays/pitft28-resistive-overlay.dtb \
    "

IMAGE_CLASSES += "sdcard_image-rpi"
```
